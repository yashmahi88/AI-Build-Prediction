## modular_code_base/vectorstore/yocto-files/meta-myhello/conf/layer.conf
```bitbake
# We have a conf and classes directory, add to BBPATH
BBPATH .= ":${LAYERDIR}"

# We have recipes-* directories, add to BBFILES
BBFILES += "${LAYERDIR}/recipes-*/*/*.bb \
            ${LAYERDIR}/recipes-*/*/*.bbappend"

BBFILE_COLLECTIONS += "meta-myhello"
BBFILE_PATTERN_meta-myhello = "^${LAYERDIR}/"
BBFILE_PRIORITY_meta-myhello = "6"

LAYERDEPENDS_meta-myhello = "core"
LAYERSERIES_COMPAT_meta-myhello = "kirkstone"
```
